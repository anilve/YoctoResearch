## Scarthgap/BuildYourOwnLinuxDistro/conf/distro/bearcreeklinux.conf
```bitbake
DISTRO = "bearcreeklinux"
DISTRO_VERSION = "0.0.1"
PACKAGE_CLASSES = "package_ipk"
MACHINE = "qemuarm64"
DISTRO_FEATURES = "ssh-server"
IMAGE_INSTALL = "wget curl"
IMAGE_FSTYPES ?= "ext4 tar.bz2"
PREFERED_PROVIDER_virtual/kernel = "linux-yocto"
```
